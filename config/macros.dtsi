macro_intl: macro_intl{
compatible = "zmk,behavior-macro";
label = "macro_intl";
#binding-cells = <0>;
bindings = <&kp LS(W)>, <&kp E>, <&kp A>, <&kp R>, <&kp E>, <&kp G>, <&kp R>, <&kp E>, <&kp A>, <&kp T>, <&kp AT_SIGN>, <&kp NUMBER_1>, <&kp NUMBER_1>;
};
macro_email: macro_email{
compatible = "zmk,behavior-macro";
label = "macro_email";
#binding-cells = <0>;
bindings = <&kp LS(M)>, <&kp A>, <&kp R>, <&kp K>, <&kp DOT>, <&kp LS(H)>, <&kp A>, <&kp N>, <&kp S>, <&kp E>, <&kp N>,
    <&kp AT_SIGN>, <&kp W>, <&kp B>, <&kp D>, <&kp DOT>, <&kp C>, <&kp O>, <&kp M>; 
};
macro_copy: macro_copy{
compatible = "zmk,behavior-macro";
label = "macro_copy";
#binding-cells = <0>;
bindings = <&kp LC(C)>;
};
macro_paste: macro_paste{
compatible = "zmk,behavior-macro";
label = "macro_paste";
#binding-cells = <0>;
bindings = <&kp LC(V)>;
};
